## Kconfig
```kconfig
menu "ESP-BSP SDL Configuration"

    choice ESP_BSP_SDL_BOARD_SELECTION
        prompt "Select Target Board"
        default ESP_BSP_SDL_BOARD_ESP_BOX_3
        help
            Select the target board for your SDL application.
            This determines which ESP-BSP will be used and configures
            the appropriate display, touch, and other hardware settings.

        config ESP_BSP_SDL_BOARD_ESP_BOX_3
            bool "ESP-Box-3"
            help
                ESP-Box-3 development board with ESP32-S3, LCD display and touch.

        config ESP_BSP_SDL_BOARD_ESP_BOX
            bool "ESP-Box"
            help
                ESP-Box development board with ESP32-S3, LCD display and touch.

        config ESP_BSP_SDL_BOARD_ESP32_C6_DEVKIT
            bool "ESP32-C6 DevKit with ILI9341 Display"
            help
                ESP32-C6 development board with external ILI9341 LCD display.

        config ESP_BSP_SDL_BOARD_M5STACK_CORE_S3
            bool "M5Stack Core S3"
            help
                M5Stack Core S3 with ESP32-S3 and built-in display.

        config ESP_BSP_SDL_BOARD_M5_ATOM_S3
            bool "M5 Atom S3"
            help
                M5 Atom S3 with ESP32-S3 and 240x240 round LCD display.

        config ESP_BSP_SDL_BOARD_ESP32_C3_LCDKIT
            bool "ESP32-C3-LCDkit"
            help
                ESP32-C3-LCDkit development board with LCD display.

        config ESP_BSP_SDL_BOARD_ESP32_P4_FUNCTION_EV
            bool "ESP32-P4 Function EV Board"
            help
                ESP32-P4 Function Evaluation Board with advanced display capabilities.

    endchoice

    config ESP_BSP_SDL_BOARD_NAME
        string
        default "esp-box-3_noglib" if ESP_BSP_SDL_BOARD_ESP_BOX_3
        default "esp-box_noglib" if ESP_BSP_SDL_BOARD_ESP_BOX
        default "esp_bsp_generic" if ESP_BSP_SDL_BOARD_ESP32_C6_DEVKIT
        default "m5stack_core_s3" if ESP_BSP_SDL_BOARD_M5STACK_CORE_S3
        default "m5_atom_s3" if ESP_BSP_SDL_BOARD_M5_ATOM_S3
        default "esp32_c3_lcdkit" if ESP_BSP_SDL_BOARD_ESP32_C3_LCDKIT
        default "esp32_p4_function_ev_board_noglib" if ESP_BSP_SDL_BOARD_ESP32_P4_FUNCTION_EV

    config ESP_BSP_SDL_SDKCONFIG_SUFFIX
        string
        default "esp-box-3" if ESP_BSP_SDL_BOARD_ESP_BOX_3
        default "esp-box" if ESP_BSP_SDL_BOARD_ESP_BOX
        default "esp32_c6_devkit" if ESP_BSP_SDL_BOARD_ESP32_C6_DEVKIT
        default "m5stack_core_s3" if ESP_BSP_SDL_BOARD_M5STACK_CORE_S3
        default "m5_atom_s3" if ESP_BSP_SDL_BOARD_M5_ATOM_S3
        default "esp32_c3_lcdkit" if ESP_BSP_SDL_BOARD_ESP32_C3_LCDKIT
        default "esp32_p4_function_ev" if ESP_BSP_SDL_BOARD_ESP32_P4_FUNCTION_EV

endmenu
```
